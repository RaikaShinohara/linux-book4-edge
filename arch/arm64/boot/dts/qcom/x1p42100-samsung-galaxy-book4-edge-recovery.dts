// SPDX-License-Identifier: BSD-3-Clause
/*
 * Recovery variant: retain the firmware framebuffer while diagnosing USB-A.
 * The normal board DTB remains the native-display test target.
 */

#include "x1p42100-samsung-galaxy-book4-edge.dts"

/ {
	model = "Samsung Galaxy Book4 Edge (NP750XQA, firmware display recovery)";
};

&backlight {
	status = "disabled";
};

&mdss_dp3 {
	status = "disabled";
};

&pmk8550_pwm {
	status = "disabled";
};

/*
 * Inherit this board's USB topology, including the MP1 repeater. Windows PnP
 * places the recovery stick at USB3/RHUB/MP1 on NP750XQA. The Samsung X Elite
 * 14-inch MP0/i2c5/GPIO184 experiment is not evidence for this board's wiring.
 */
